## arch/arm/cpu/arm926ejs/orion5x/Kconfig
```kconfig
if ORION5X

choice
	prompt "Marvell Orion board select"

config TARGET_EDMINIV2
	bool "LaCie Ethernet Disk mini V2"

config TARGET_NSA220
	bool "ZyXEL NSA-220"

endchoice

config SYS_SOC
	default "orion5x"

source "board/LaCie/edminiv2/Kconfig"
source "board/ZyXEL/nsa220/Kconfig"

endif
```

## board/ZyXEL/nsa220/Kconfig
```kconfig
if TARGET_NSA220

config SYS_BOARD
	default "nsa220"

config SYS_VENDOR
	default "ZyXEL"

config SYS_CONFIG_NAME
	default "nsa220"

endif
```
